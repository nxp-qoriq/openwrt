## package/network/services/eds/Config.in
```kconfig
config EDGESCALE_BUSYBOX_SUPPORT
	bool "Busybox support for Edgescale"
	depends on PACKAGE_edgescale
	select BUSYBOX_CUSTOM
	select BUSYBOX_CONFIG_HOSTNAME
	default y
	help
	  This enables Busybox options required by Edgescale.
```
